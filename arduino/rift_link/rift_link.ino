/*
 * RIFT's own board: the fleet hub's IR transmitter, IR receiver and buzzer,
 * on an Arduino UNO plugged into the PC that runs RIFT.
 *
 * With it RIFT can drive and greet the IR robots (IDA, MILA, WHIP, KIDA-01)
 * the same way NORA does, hear the IR traffic around it (NORA's "I am here"
 * beacon, the robots' phrases, any remote), and say the fleet's Brainfuck
 * phrases out loud like the robots do.
 *
 * WIRING
 *   IR LED (940 nm)   pin 3 -> 100 ohm -> LED anode, cathode -> GND
 *                     (pin 3 is IRremote's send pin on the UNO; for range,
 *                      drive the LED through an NPN transistor)
 *   IR receiver       OUT -> pin 2, VCC -> 5 V, GND -> GND  (VS1838B / TSOP38238)
 *   Passive buzzer    pin 8 -> buzzer -> GND
 *
 * SERIAL (115200 baud, one command per line)
 *   WHO                 -> "I am Rift"   (the fleet-wide handshake)
 *   LINK:<r>:<c>        send a fleet link command over IR, like NORA's /link:
 *                         r = IDA MILA WHIP KIDA (or I M W K)
 *                         c = fw bw left right stop auto manual speed
 *                       -> "OK" / "ERR"
 *   SAY:<r>:<p>         send phrase p (0-6: hello, how are you, happy, curious,
 *                       sleepy, play, bye) to robot r over IR, after beeping it
 *   TALK:<u>            beep Brainfuck utterance u (0-13) on the buzzer
 *   BEEP:<hz>:<ms>      a plain beep
 *   Every IR frame it hears is reported as
 *   IR:<protocol>:<address hex>:<command hex>[:R]   (R = a held-button repeat)
 *
 * Timer note: on the UNO, tone() and IRremote both use Timer2, so the
 * receiver is paused while the buzzer talks and restarted after.
 */

#include <IRremote.hpp>
#include "talk_bf.h"   // the fleet's Brainfuck phrasebook (generated by Fleet/brainfuck_talk.py)

#define IR_RECEIVE_PIN 2
#define IR_SEND_PIN    3
#define BUZZER_PIN     8

// The fleet IR link (same as NORA's esp32.ino): one Samsung address per robot,
// commands 0x48-0x4F to drive, 0x40-0x46 for phrases.
#define IDA_LINK_ADDRESS  0x0DA1
#define MILA_LINK_ADDRESS 0x0DA2
#define WHIP_LINK_ADDRESS 0x0DA3
#define KIDA_LINK_ADDRESS 0x0DA4
#define TALK_FIRST 0x40

const uint8_t RIFT_VOICE_PCT = 70;   // the hub's voice: lower than every robot

String line;
bool talking = false;
uint16_t pendingAddr = 0;            // a phrase to send over IR once it's been said aloud
uint8_t pendingCode = 0;

uint16_t robotAddress(String r) {
  r.toUpperCase();
  if (r == "IDA" || r == "I") return IDA_LINK_ADDRESS;
  if (r == "MILA" || r == "M") return MILA_LINK_ADDRESS;
  if (r == "WHIP" || r == "W") return WHIP_LINK_ADDRESS;
  if (r == "KIDA" || r == "K") return KIDA_LINK_ADDRESS;
  return 0;
}

int linkCode(String c) {
  c.toLowerCase();
  const char* names[] = { "fw", "bw", "left", "right", "stop", "auto", "manual", "speed" };
  for (int i = 0; i < 8; i++)
    if (c == names[i]) return 0x48 + i;
  return -1;
}

void irSend(uint16_t address, uint8_t command) {
  IrReceiver.stop();                  // don't hear our own frame
  IrSender.sendSamsung(address, command, 0);
  IrReceiver.start();
}

void startTalking(int u) {
  if (u < 0 || u >= TALK_UTTERANCES) return;
  IrReceiver.stop();                  // tone() needs Timer2
  talkStart(u);
  talking = true;
}

void handleLine(String cmd) {
  cmd.trim();
  if (cmd == "WHO") {
    Serial.println("I am Rift");
  } else if (cmd.startsWith("LINK:")) {
    int sep = cmd.indexOf(':', 5);
    uint16_t addr = sep > 0 ? robotAddress(cmd.substring(5, sep)) : 0;
    int code = sep > 0 ? linkCode(cmd.substring(sep + 1)) : -1;
    if (!addr || code < 0) { Serial.println("ERR"); return; }
    irSend(addr, code);
    Serial.println("OK");
  } else if (cmd.startsWith("SAY:")) {
    int sep = cmd.indexOf(':', 4);
    uint16_t addr = sep > 0 ? robotAddress(cmd.substring(4, sep)) : 0;
    int p = sep > 0 ? cmd.substring(sep + 1).toInt() : -1;
    if (!addr || p < 0 || p > 6) { Serial.println("ERR"); return; }
    pendingAddr = addr;
    pendingCode = TALK_FIRST + p;
    startTalking(p);                  // say it, then send it (so the answer doesn't talk over us)
    Serial.println("OK");
  } else if (cmd.startsWith("TALK:")) {
    startTalking(cmd.substring(5).toInt());
    Serial.println("OK");
  } else if (cmd.startsWith("BEEP:")) {
    int sep = cmd.indexOf(':', 5);
    unsigned int hz = cmd.substring(5, sep).toInt();
    unsigned long ms = sep > 0 ? cmd.substring(sep + 1).toInt() : 100;
    if (!talking) {
      IrReceiver.stop();
      tone(BUZZER_PIN, hz, ms);
      delay(ms);
      noTone(BUZZER_PIN);
      IrReceiver.start();
    }
    Serial.println("OK");
  } else if (cmd.length()) {
    Serial.println("ERR");
  }
}

void reportIR() {
  if (!IrReceiver.decode()) return;
  auto& d = IrReceiver.decodedIRData;
  if (d.protocol != UNKNOWN) {
    Serial.print("IR:");
    Serial.print(getProtocolString(d.protocol));
    Serial.print(':');
    Serial.print(d.address, HEX);
    Serial.print(':');
    Serial.print(d.command, HEX);
    if (d.flags & IRDATA_FLAGS_IS_REPEAT) Serial.print(":R");
    Serial.println();
  }
  IrReceiver.resume();
}

void setup() {
  Serial.begin(115200);
  pinMode(BUZZER_PIN, OUTPUT);
  IrReceiver.begin(IR_RECEIVE_PIN, DISABLE_LED_FEEDBACK);
  IrSender.begin(IR_SEND_PIN);
  Serial.println("I am Rift");
}

void loop() {
  while (Serial.available()) {
    char c = Serial.read();
    if (c == '\n') {
      handleLine(line);
      line = "";
    } else if (c != '\r' && line.length() < 40) {
      line += c;
    }
  }
  if (talking && !talkStep(BUZZER_PIN, RIFT_VOICE_PCT)) {
    talking = false;
    IrReceiver.start();
    if (pendingAddr) {
      irSend(pendingAddr, pendingCode);
      pendingAddr = 0;
    }
  }
  if (!talking) reportIR();
}
